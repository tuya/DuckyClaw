## IM/Kconfig
```kconfig
menu "IM Config"
    config OUTBOUND_STACK_SIZE
        int "IM outbound thread stack size (bytes)"
        default 12288
        help
            Stack size in bytes for the IM outbound thread (default 12*1024).
    config IM_FS_POLL_STACK
        int "IM feishu poll thread stack size (bytes)"
        default 16384
        help
            Stack size in bytes for the IM feishu poll thread (default 16*1024).
    config IM_TG_POLL_STACK
        int "IM telegram poll thread stack size (bytes)"
        default 12288
        help
            Stack size in bytes for the IM telegram poll thread (default 12*1024).
    config IM_DC_POLL_STACK
        int "IM discord poll thread stack size (bytes)"
        default 12288
        help
            Stack size in bytes for the IM discord poll thread (default 12*1024).
    config IM_WX_POLL_STACK
        int "IM weixin poll thread stack size (bytes)"
        default 14336
        help
            Stack size in bytes for the IM weixin poll thread (default 14*1024).
    config IM_WX_QR_STACK
        int "IM weixin QR code thread stack size (bytes)"
        default 10240
        help
            Stack size in bytes for the IM weixin QR code thread (default 10*1024).
endmenu
```

## Kconfig
```kconfig
menu "configure app (DuckyClaw) "

rsource "./ai_components/Kconfig"
rsource "./cron_service/Kconfig"
rsource "./gateway/Kconfig"
rsource "./IM/Kconfig"
rsource "./agent/Kconfig"
rsource "./tools/Kconfig"

endmenu
```

## gateway/Kconfig
```kconfig
menu "Gateway (WebSocket) Config"
    config WS_SERVER_STACK_SIZE
        int "WebSocket server thread stack size (bytes)"
        default 10240
        help
            Stack size in bytes for the WebSocket server thread (default 10*1024).

    config ACP_CLIENT_STACK_SIZE
        int "ACP client thread stack size (bytes)"
        default 10240
        help
            Stack size in bytes for the ACP client thread (default 10*1024).
endmenu
```

## tools/Kconfig
```kconfig
menu "Tools (Filesystem) Config"
    config CLAW_USE_SDCARD
        bool "Use SD card for filesystem"
        default n
        help
            When enabled (y), use SD card filesystem (tkl_fs, root /sdcard).
            When disabled (n), use internal flash (tal_fs).
            Typically disable on Linux (PLATFORM_LINUX) targets.

    config ENABLE_HARDWARE_MCP
        bool "Enable hardware MCP"
        default n
        help
            When enabled (y), enable hardware MCP tools.
            When disabled (n), disable hardware MCP tools.
endmenu
```
